
/*******************************************************************************
* 文件名 : 12864.c

* 版本     作者            日期            说明
* V1.0     zhi-z          2014/08/04       初始版本

* 描述   : MCU: STC15F2K60S2     晶振: 22.1184   MHz
           
*******************************************************************************/

#include "12864.h"


/*******************************************************************************
* 函数描述 : 写位置函数
* 隶属模块 : 外部
* 输入参数 : unsigned char x,unsigned char y        x,y为要写入的行,列
* 返回参数 : 
*******************************************************************************/

void LCD_12864_write_POS(unsigned char x , unsigned char y )
{
	unsigned char  POS ;
	if (x == 0)
	x = 0x80 ; 
	if (x == 1)
	x = 0x90 ;  
	if (x == 2)
	x = 0x88 ; 
	if (x == 3)
	x = 0x98 ;  
	POS = x + y ;
	LCD_12864_write_cmd (POS) ;  	
}

 
/*******************************************************************************
* 函数描述 : 12864写数据函数
* 隶属模块 : 内部
* 输入参数 : unsigned char dat ,数据
* 返回参数 : 无
*******************************************************************************/

void LCD_12864_write_dat(unsigned char dat)
{
	LCD_12864_RS = 1 ;	//数据
	LCD_12864_RW = 0 ;	//写
	LCD_12864_EN = 0 ;
	P0 = dat ;
	LCD_12864_delay(5) ;
	LCD_12864_EN= 1 ;
	LCD_12864_delay(5) ;
	LCD_12864_EN = 0 ;	
}

/*******************************************************************************
* 函数描述 : 12864写指令函数
* 隶属模块 : 内部
* 输入参数 : unsigned char cmd ,命令
* 返回参数 : 无
*******************************************************************************/

void LCD_12864_write_cmd(unsigned char cmd) 
{
	LCD_12864_RS = 0 ;	//指令
	LCD_12864_RW = 0 ;	 //写
	LCD_12864_EN = 0 ;
	P0 = cmd ;
	LCD_12864_delay (5) ;
	LCD_12864_EN = 1 ;
	LCD_12864_delay (5) ;
	LCD_12864_EN = 0 ;
}

/*******************************************************************************
* 函数描述 : 液晶初始化函数
* 隶属模块 : 外部
* 输入参数 : 无 
* 返回参数 : 无
*******************************************************************************/

void LCD_12864_INIT()
{
//	LCD_12864_PSB = 1 ; 			//设置并口方式
	LCD_12864_write_cmd (0x30) ;		// 设定为8为数据操作
	LCD_12864_delay(5) ;
	LCD_12864_write_cmd (0x0c) ;		//设置整体显示开，游标关，光标位置反白关
	LCD_12864_delay(5) ;
	LCD_12864_write_cmd (0x01) ;		//清除显示，DDRAM地址计数器地址设为00H
										//只能用来字符,汉字,不能用来清除图片
	LCD_12864_delay(5) ;
	LCD_12864_back_light = 0;
}

 
/*******************************************************************************
* 函数描述 : 12864延时函数
* 隶属模块 : 内部
* 输入参数 : unsigned int z ,延时参数
* 返回参数 : 无
*******************************************************************************/

void LCD_12864_delay(unsigned int z)
{
	unsigned int i , j ;
	for (i = z ; i > 0 ; i--)
		for (j = 1700 ; j > 0 ; j--) ;
}

/*******************************************************************************
* 函数描述 : 关闭液晶背光
* 隶属模块 : 外部
* 输入参数 : 无
* 返回参数 : 无
*******************************************************************************/

void close_LCD_12864_back_light()
{
	LCD_12864_back_light = 1;
}

/*******************************************************************************
* 函数描述 : 打开液晶背光
* 隶属模块 : 外部
* 输入参数 : 无
* 返回参数 : 无
*******************************************************************************/

void open_LCD_12864_back_light()
{
	LCD_12864_back_light = 0;
}

 
/*******************************************************************************
* 函数描述 : 显示汉字或字符
* 隶属模块 : 外部
* 输入参数 : x ,y 为字体 字符的行,列坐标 ,p为指向字符串的指针
* 返回参数 : 无
*******************************************************************************/
void show_Typeface(unsigned char x,unsigned char y,unsigned char *p)
{
	
	LCD_12864_write_POS (x,y) ;
	
	while (*p != '\0')
	{
		LCD_12864_write_dat (*p++ ) ;							   
	}
}

