/*******************************************************************************
* 文件名 : DS1302.c
* 实现功能:DS1302驱动程序
* 版本     作者            日期            说明
* V1.0     zhi-z            2015/08/30       初始版本

* 描述   : MCU: STC15F2K60S2     晶振:22.1184    MHz
           
*******************************************************************************/  
#include"STC15F2K60S2.h"
#include"DS1302.h"
#include"intrins.h"

unsigned char Time_buf[8]={0x20,0x01,0x59,0x12,0x01,0x01,0x01,0x15};//年，秒，分，时，日，月，星期，年
/*******************************************************************************
* 功能描述 : DS1302初始化
* 函数属性 : 外部
* 输入参数 : 无
* 返回参数 : 无
* 函数详解 :上电运行时，在VCC大于或小于2.5V之前,RST必须
*			保持低电平，只有在SCLK为低电平时，RST才能被置高 
*******************************************************************************/
void DS1302_Init()
{
	RST = 0;
	SCLK = 0;
}

/*******************************************************************************
* 功能描述 : 数据输入函数
* 函数属性 : 外部
* 输入参数 : 无
* 返回参数 : 无
* 函数详解 : 数据输入，一个字节的输入将在下8个时钟周期的上升沿完成，
*			 数据传输从字节最低位开始
*******************************************************************************/
void DS1302_Data_Input(unsigned char Address,unsigned char Data)
{
	unsigned char i;
	RST = 1;//启动DS1302总线
	Address = Address & 0xFE;//最低位置0，寄存器0位时写，1时读，这时为写数据
	for(i=0;i<8;i++)
	{
		SCLK = 0;
		if(Address&0x01)
		{
			DAT = 1;
		}
		else
		{
			DAT = 0;
		}	
		SCLK = 1;//上升沿写入指令
		Address = Address>>1;
	}
	for(i=0;i<8;i++)
	{
		SCLK = 0;
		if(Data&0x01)
		{
			DAT = 1;
		}
		else
		{
			DAT = 0;
		}
		SCLK = 1;//上升沿写入数据
		Data = Data>>1;
	}
	SCLK = 0;
	RST = 0;//关闭DS1302总线
}

/*
*/
/*******************************************************************************
* 功能描述 : 数据输出函数
* 函数属性 : 外部
* 输入参数 : 无
* 返回参数 : 无
* 函数详解 : 数据输出，一个字节的数据将在下个8个时钟周期的下降沿被输出。注意第一位输出
*			 是在最后一位控制指令所在的下降沿被输出，要求RST保持位高电平
*******************************************************************************/
unsigned char DS1302_Data_Output(unsigned char Address)
{
	unsigned char i;
	unsigned char temp;
	RST = 1;//启动DS1302总线
	Address = Address | 0x01;//最低位置1，寄存器0位时写，1时读，这时为读数据
	for(i=0;i<8;i++)
	{
		SCLK = 0;
		if(Address&0x01)
		{
			DAT = 1;
		}
		else
		{
			DAT = 0;
		}
		SCLK = 1;//上升沿写入指令
		Address = Address>>1;
	}
	/*数据读取，从最低位开始读*/
	for(i=0;i<8;i++)
	{
		SCLK=0;//下降沿读取数据	
		temp = temp >> 1;
		if (DAT)
		{
			temp |= 0x80;
		}
		else
		{
			temp &= 0x7F;
		}
		SCLK=1;
	}
	SCLK=0;
	RST = 0;//关闭DS1302总线
	return temp;
}

/*******************************************************************************
* 功能描述 : 初始化时间
* 函数属性 : 外部
* 输入参数 : 无
* 返回参数 : 无
* 函数详解 : 
*******************************************************************************/
void DS1302_Write_Time(void)
{
	DS1302_Data_Input(DS1302_CONTROL_ADD,0x00);		//关闭写保护，允许数据写入寄存器，数据内容为0（写入允许）
	DS1302_Data_Input(DS1302_SEC_ADD,0x80);			//CH位置高，振荡器停止，置低，振荡器工作允许	
	DS1302_Data_Input(DS1302_CHARGER_ADD,0xa9);
	//涓流充电，7~4位TCS=1010，使能涓流充电
	//3~2位DS=01，选择一个二极管，DS=10，选择两个二极管，等于其他值，均被禁止充电
	//1~0位RS=00，无电阻，不能充电，RS=01，2k，RS=10，4k，RS=11，8k
	
	/*初始值*/
	DS1302_Data_Input(DS1302_SEC_ADD,Time_buf[1]);		//秒
	DS1302_Data_Input(DS1302_MIN_ADD,Time_buf[2]);		//分
	DS1302_Data_Input(DS1302_HR_ADD,Time_buf[3]);		//时
	DS1302_Data_Input(DS1302_DAY_ADD,Time_buf[4]);		//日
	DS1302_Data_Input(DS1302_MONTH_ADD,Time_buf[5]);	//月
	DS1302_Data_Input(DS1302_WEEK_ADD,Time_buf[6]);		//星期
	DS1302_Data_Input(DS1302_YEAR_ADD,Time_buf[7]);		//年
	
	DS1302_Data_Input(DS1302_CONTROL_ADD,0x80);			//打开写保护
}

/*******************************************************************************
* 功能描述 : 读取时间
* 函数属性 : 外部
* 输入参数 : 无
* 返回参数 : 无
* 函数详解 : 
*******************************************************************************/
void DS1302_Read_Time(void)  
{
	Time_buf[1]=(DS1302_Data_Output(DS1302_SEC_ADD))&0x7f;	//秒，屏蔽秒的第7位，避免超出59
	Time_buf[2]=DS1302_Data_Output(DS1302_MIN_ADD);			//分
	Time_buf[3]=DS1302_Data_Output(DS1302_HR_ADD)&0x3F;		//时  3f --	0011 1111
	Time_buf[4]=DS1302_Data_Output(DS1302_DAY_ADD);			//日
	Time_buf[5]=DS1302_Data_Output(DS1302_MONTH_ADD);		//月
	Time_buf[6]=DS1302_Data_Output(DS1302_WEEK_ADD);		//星期
	Time_buf[7]=DS1302_Data_Output(DS1302_YEAR_ADD);		//年	
}
