/*******************************************************************************
*文件名     : main.c
*作用       : 程序入口
*原理       : 无
********************************************************************************
*版本     作者            日期            说明
*V0.1                   2015/7/25     初始版本
********************************************************************************/
#include "adc.h"
#include "intrins.h"
#include "uart.h"


/*******************************************************************************
* 功能描述 : 延时函数
* 函数属性 : 外部
* 输入参数 : 无
* 返回参数 : 无
* 函数详解 : 
      
*******************************************************************************/

void Delay50ms()		//@22.1184MHz
{
	unsigned char i, j, k;

	_nop_();
	_nop_();
	i = 5;
	j = 52;
	k = 195;
	do
	{
		do
		{
			while (--k);
		} while (--j);
	} while (--i);
}


/*******************************************************************************
* 功能描述 : 主函数
* 函数属性 : 
* 输入参数 : 无
* 返回参数 : 无
* 函数详解 : 
      
*******************************************************************************/
void main(void)
{
	   unsigned char dis2[]={"0.00000V"};		  //存放数据
  /*
  	10_bit = 1024*(Vi/Vc)   Vc为单片机实际工作电压 ，Vi为模拟信号输入通道输入电压。
  */
	ACD_Init();
	UartInit();
	
	while(1)
	{
		UART_Send_Str("输出的结果为：");
		UART_Put_Num(ADC_Out()*(500000/1024)/100000);
		UART_Send_Str(".");
		UART_Put_Num(ADC_Out()*(500000/1024)%100000);
		UART_Send_Str("V");
		UART_Send_Str("\r\n");
		Delay50ms();

	  /*数据处理第二种方式*/
//	  dis2[0]=(ADC_Out() *(500000/1024)/100000)+'0';
//	  dis2[2]=(ADC_Out() *(500000/1024)/10000%10)+'0';
//	  dis2[3]=(ADC_Out() *(500000/1024)/1000%10)+'0';
//	  dis2[4]=(ADC_Out() *(500000/1024)/100%10)+'0';
//	  dis2[5]=(ADC_Out() *(500000/1024)/10%10)+'0';
//	  dis2[6]=(ADC_Out() *(500000/1024)/1%10)+'0';
//
//	  UART_Send_Str("测得电压为:\r\n           ");
//	  UART_Send_Str(dis2);
//	  UART_Send_Str("\r\n");
//	  Delay50ms();
//	  Delay50ms();
//	  Delay50ms();
//	  Delay50ms();


	}  



			

}